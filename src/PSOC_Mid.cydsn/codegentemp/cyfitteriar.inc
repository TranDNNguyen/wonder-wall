;
; File Name: cyfitteriar.inc
; 
; PSoC Creator  4.1 Update 1
;
; Description:
; 
;
;-------------------------------------------------------------------------------
; Copyright (c) 2007-2017 Cypress Semiconductor.  All rights reserved.
; You may use this file only in accordance with the license, terms, conditions, 
; disclaimers, and limitations in the end user license agreement accompanying 
; the software package with which this file was provided.
;-------------------------------------------------------------------------------

#ifndef INCLUDED_CYFITTERIAR_INC
#define INCLUDED_CYFITTERIAR_INC
    INCLUDE cydeviceiar_trm.inc

/* S0 */
S0__0__DM__MASK EQU 0x7000
S0__0__DM__SHIFT EQU 12
S0__0__DR EQU CYREG_PRT0_DR
S0__0__HSIOM EQU CYREG_HSIOM_PORT_SEL0
S0__0__HSIOM_MASK EQU 0x000F0000
S0__0__HSIOM_SHIFT EQU 16
S0__0__INTCFG EQU CYREG_PRT0_INTCFG
S0__0__INTSTAT EQU CYREG_PRT0_INTSTAT
S0__0__MASK EQU 0x10
S0__0__OUT_SEL EQU CYREG_UDB_PA0_CFG10
S0__0__OUT_SEL_SHIFT EQU 8
S0__0__OUT_SEL_VAL EQU 3
S0__0__PA__CFG0 EQU CYREG_UDB_PA0_CFG0
S0__0__PA__CFG1 EQU CYREG_UDB_PA0_CFG1
S0__0__PA__CFG10 EQU CYREG_UDB_PA0_CFG10
S0__0__PA__CFG11 EQU CYREG_UDB_PA0_CFG11
S0__0__PA__CFG12 EQU CYREG_UDB_PA0_CFG12
S0__0__PA__CFG13 EQU CYREG_UDB_PA0_CFG13
S0__0__PA__CFG14 EQU CYREG_UDB_PA0_CFG14
S0__0__PA__CFG2 EQU CYREG_UDB_PA0_CFG2
S0__0__PA__CFG3 EQU CYREG_UDB_PA0_CFG3
S0__0__PA__CFG4 EQU CYREG_UDB_PA0_CFG4
S0__0__PA__CFG5 EQU CYREG_UDB_PA0_CFG5
S0__0__PA__CFG6 EQU CYREG_UDB_PA0_CFG6
S0__0__PA__CFG7 EQU CYREG_UDB_PA0_CFG7
S0__0__PA__CFG8 EQU CYREG_UDB_PA0_CFG8
S0__0__PA__CFG9 EQU CYREG_UDB_PA0_CFG9
S0__0__PC EQU CYREG_PRT0_PC
S0__0__PC2 EQU CYREG_PRT0_PC2
S0__0__PORT EQU 0
S0__0__PS EQU CYREG_PRT0_PS
S0__0__SHIFT EQU 4
S0__DR EQU CYREG_PRT0_DR
S0__INTCFG EQU CYREG_PRT0_INTCFG
S0__INTSTAT EQU CYREG_PRT0_INTSTAT
S0__MASK EQU 0x10
S0__PA__CFG0 EQU CYREG_UDB_PA0_CFG0
S0__PA__CFG1 EQU CYREG_UDB_PA0_CFG1
S0__PA__CFG10 EQU CYREG_UDB_PA0_CFG10
S0__PA__CFG11 EQU CYREG_UDB_PA0_CFG11
S0__PA__CFG12 EQU CYREG_UDB_PA0_CFG12
S0__PA__CFG13 EQU CYREG_UDB_PA0_CFG13
S0__PA__CFG14 EQU CYREG_UDB_PA0_CFG14
S0__PA__CFG2 EQU CYREG_UDB_PA0_CFG2
S0__PA__CFG3 EQU CYREG_UDB_PA0_CFG3
S0__PA__CFG4 EQU CYREG_UDB_PA0_CFG4
S0__PA__CFG5 EQU CYREG_UDB_PA0_CFG5
S0__PA__CFG6 EQU CYREG_UDB_PA0_CFG6
S0__PA__CFG7 EQU CYREG_UDB_PA0_CFG7
S0__PA__CFG8 EQU CYREG_UDB_PA0_CFG8
S0__PA__CFG9 EQU CYREG_UDB_PA0_CFG9
S0__PC EQU CYREG_PRT0_PC
S0__PC2 EQU CYREG_PRT0_PC2
S0__PORT EQU 0
S0__PS EQU CYREG_PRT0_PS
S0__SHIFT EQU 4

/* SPIS */
SPIS_miso_s__0__DM__MASK EQU 0x38000
SPIS_miso_s__0__DM__SHIFT EQU 15
SPIS_miso_s__0__DR EQU CYREG_PRT0_DR
SPIS_miso_s__0__HSIOM EQU CYREG_HSIOM_PORT_SEL0
SPIS_miso_s__0__HSIOM_GPIO EQU 0
SPIS_miso_s__0__HSIOM_I2C EQU 14
SPIS_miso_s__0__HSIOM_I2C_SDA EQU 14
SPIS_miso_s__0__HSIOM_MASK EQU 0x00F00000
SPIS_miso_s__0__HSIOM_SHIFT EQU 20
SPIS_miso_s__0__HSIOM_SPI EQU 15
SPIS_miso_s__0__HSIOM_SPI_MISO EQU 15
SPIS_miso_s__0__HSIOM_UART EQU 9
SPIS_miso_s__0__HSIOM_UART_TX EQU 9
SPIS_miso_s__0__INTCFG EQU CYREG_PRT0_INTCFG
SPIS_miso_s__0__INTSTAT EQU CYREG_PRT0_INTSTAT
SPIS_miso_s__0__MASK EQU 0x20
SPIS_miso_s__0__OUT_SEL EQU CYREG_UDB_PA0_CFG10
SPIS_miso_s__0__OUT_SEL_SHIFT EQU 10
SPIS_miso_s__0__OUT_SEL_VAL EQU -1
SPIS_miso_s__0__PA__CFG0 EQU CYREG_UDB_PA0_CFG0
SPIS_miso_s__0__PA__CFG1 EQU CYREG_UDB_PA0_CFG1
SPIS_miso_s__0__PA__CFG10 EQU CYREG_UDB_PA0_CFG10
SPIS_miso_s__0__PA__CFG11 EQU CYREG_UDB_PA0_CFG11
SPIS_miso_s__0__PA__CFG12 EQU CYREG_UDB_PA0_CFG12
SPIS_miso_s__0__PA__CFG13 EQU CYREG_UDB_PA0_CFG13
SPIS_miso_s__0__PA__CFG14 EQU CYREG_UDB_PA0_CFG14
SPIS_miso_s__0__PA__CFG2 EQU CYREG_UDB_PA0_CFG2
SPIS_miso_s__0__PA__CFG3 EQU CYREG_UDB_PA0_CFG3
SPIS_miso_s__0__PA__CFG4 EQU CYREG_UDB_PA0_CFG4
SPIS_miso_s__0__PA__CFG5 EQU CYREG_UDB_PA0_CFG5
SPIS_miso_s__0__PA__CFG6 EQU CYREG_UDB_PA0_CFG6
SPIS_miso_s__0__PA__CFG7 EQU CYREG_UDB_PA0_CFG7
SPIS_miso_s__0__PA__CFG8 EQU CYREG_UDB_PA0_CFG8
SPIS_miso_s__0__PA__CFG9 EQU CYREG_UDB_PA0_CFG9
SPIS_miso_s__0__PC EQU CYREG_PRT0_PC
SPIS_miso_s__0__PC2 EQU CYREG_PRT0_PC2
SPIS_miso_s__0__PORT EQU 0
SPIS_miso_s__0__PS EQU CYREG_PRT0_PS
SPIS_miso_s__0__SHIFT EQU 5
SPIS_miso_s__DR EQU CYREG_PRT0_DR
SPIS_miso_s__INTCFG EQU CYREG_PRT0_INTCFG
SPIS_miso_s__INTSTAT EQU CYREG_PRT0_INTSTAT
SPIS_miso_s__MASK EQU 0x20
SPIS_miso_s__PA__CFG0 EQU CYREG_UDB_PA0_CFG0
SPIS_miso_s__PA__CFG1 EQU CYREG_UDB_PA0_CFG1
SPIS_miso_s__PA__CFG10 EQU CYREG_UDB_PA0_CFG10
SPIS_miso_s__PA__CFG11 EQU CYREG_UDB_PA0_CFG11
SPIS_miso_s__PA__CFG12 EQU CYREG_UDB_PA0_CFG12
SPIS_miso_s__PA__CFG13 EQU CYREG_UDB_PA0_CFG13
SPIS_miso_s__PA__CFG14 EQU CYREG_UDB_PA0_CFG14
SPIS_miso_s__PA__CFG2 EQU CYREG_UDB_PA0_CFG2
SPIS_miso_s__PA__CFG3 EQU CYREG_UDB_PA0_CFG3
SPIS_miso_s__PA__CFG4 EQU CYREG_UDB_PA0_CFG4
SPIS_miso_s__PA__CFG5 EQU CYREG_UDB_PA0_CFG5
SPIS_miso_s__PA__CFG6 EQU CYREG_UDB_PA0_CFG6
SPIS_miso_s__PA__CFG7 EQU CYREG_UDB_PA0_CFG7
SPIS_miso_s__PA__CFG8 EQU CYREG_UDB_PA0_CFG8
SPIS_miso_s__PA__CFG9 EQU CYREG_UDB_PA0_CFG9
SPIS_miso_s__PC EQU CYREG_PRT0_PC
SPIS_miso_s__PC2 EQU CYREG_PRT0_PC2
SPIS_miso_s__PORT EQU 0
SPIS_miso_s__PS EQU CYREG_PRT0_PS
SPIS_miso_s__SHIFT EQU 5
SPIS_mosi_s__0__DM__MASK EQU 0x07
SPIS_mosi_s__0__DM__SHIFT EQU 0
SPIS_mosi_s__0__DR EQU CYREG_PRT3_DR
SPIS_mosi_s__0__HSIOM EQU CYREG_HSIOM_PORT_SEL3
SPIS_mosi_s__0__HSIOM_GPIO EQU 0
SPIS_mosi_s__0__HSIOM_I2C EQU 14
SPIS_mosi_s__0__HSIOM_I2C_SCL EQU 14
SPIS_mosi_s__0__HSIOM_MASK EQU 0x0000000F
SPIS_mosi_s__0__HSIOM_SHIFT EQU 0
SPIS_mosi_s__0__HSIOM_SPI EQU 15
SPIS_mosi_s__0__HSIOM_SPI_MOSI EQU 15
SPIS_mosi_s__0__HSIOM_UART EQU 9
SPIS_mosi_s__0__HSIOM_UART_RX EQU 9
SPIS_mosi_s__0__INTCFG EQU CYREG_PRT3_INTCFG
SPIS_mosi_s__0__INTSTAT EQU CYREG_PRT3_INTSTAT
SPIS_mosi_s__0__MASK EQU 0x01
SPIS_mosi_s__0__PA__CFG0 EQU CYREG_UDB_PA3_CFG0
SPIS_mosi_s__0__PA__CFG1 EQU CYREG_UDB_PA3_CFG1
SPIS_mosi_s__0__PA__CFG10 EQU CYREG_UDB_PA3_CFG10
SPIS_mosi_s__0__PA__CFG11 EQU CYREG_UDB_PA3_CFG11
SPIS_mosi_s__0__PA__CFG12 EQU CYREG_UDB_PA3_CFG12
SPIS_mosi_s__0__PA__CFG13 EQU CYREG_UDB_PA3_CFG13
SPIS_mosi_s__0__PA__CFG14 EQU CYREG_UDB_PA3_CFG14
SPIS_mosi_s__0__PA__CFG2 EQU CYREG_UDB_PA3_CFG2
SPIS_mosi_s__0__PA__CFG3 EQU CYREG_UDB_PA3_CFG3
SPIS_mosi_s__0__PA__CFG4 EQU CYREG_UDB_PA3_CFG4
SPIS_mosi_s__0__PA__CFG5 EQU CYREG_UDB_PA3_CFG5
SPIS_mosi_s__0__PA__CFG6 EQU CYREG_UDB_PA3_CFG6
SPIS_mosi_s__0__PA__CFG7 EQU CYREG_UDB_PA3_CFG7
SPIS_mosi_s__0__PA__CFG8 EQU CYREG_UDB_PA3_CFG8
SPIS_mosi_s__0__PA__CFG9 EQU CYREG_UDB_PA3_CFG9
SPIS_mosi_s__0__PC EQU CYREG_PRT3_PC
SPIS_mosi_s__0__PC2 EQU CYREG_PRT3_PC2
SPIS_mosi_s__0__PORT EQU 3
SPIS_mosi_s__0__PS EQU CYREG_PRT3_PS
SPIS_mosi_s__0__SHIFT EQU 0
SPIS_mosi_s__DR EQU CYREG_PRT3_DR
SPIS_mosi_s__INTCFG EQU CYREG_PRT3_INTCFG
SPIS_mosi_s__INTSTAT EQU CYREG_PRT3_INTSTAT
SPIS_mosi_s__MASK EQU 0x01
SPIS_mosi_s__PA__CFG0 EQU CYREG_UDB_PA3_CFG0
SPIS_mosi_s__PA__CFG1 EQU CYREG_UDB_PA3_CFG1
SPIS_mosi_s__PA__CFG10 EQU CYREG_UDB_PA3_CFG10
SPIS_mosi_s__PA__CFG11 EQU CYREG_UDB_PA3_CFG11
SPIS_mosi_s__PA__CFG12 EQU CYREG_UDB_PA3_CFG12
SPIS_mosi_s__PA__CFG13 EQU CYREG_UDB_PA3_CFG13
SPIS_mosi_s__PA__CFG14 EQU CYREG_UDB_PA3_CFG14
SPIS_mosi_s__PA__CFG2 EQU CYREG_UDB_PA3_CFG2
SPIS_mosi_s__PA__CFG3 EQU CYREG_UDB_PA3_CFG3
SPIS_mosi_s__PA__CFG4 EQU CYREG_UDB_PA3_CFG4
SPIS_mosi_s__PA__CFG5 EQU CYREG_UDB_PA3_CFG5
SPIS_mosi_s__PA__CFG6 EQU CYREG_UDB_PA3_CFG6
SPIS_mosi_s__PA__CFG7 EQU CYREG_UDB_PA3_CFG7
SPIS_mosi_s__PA__CFG8 EQU CYREG_UDB_PA3_CFG8
SPIS_mosi_s__PA__CFG9 EQU CYREG_UDB_PA3_CFG9
SPIS_mosi_s__PC EQU CYREG_PRT3_PC
SPIS_mosi_s__PC2 EQU CYREG_PRT3_PC2
SPIS_mosi_s__PORT EQU 3
SPIS_mosi_s__PS EQU CYREG_PRT3_PS
SPIS_mosi_s__SHIFT EQU 0
SPIS_SCB__BIST_CONTROL EQU CYREG_SCB1_BIST_CONTROL
SPIS_SCB__BIST_DATA EQU CYREG_SCB1_BIST_DATA
SPIS_SCB__CTRL EQU CYREG_SCB1_CTRL
SPIS_SCB__EZ_DATA00 EQU CYREG_SCB1_EZ_DATA00
SPIS_SCB__EZ_DATA01 EQU CYREG_SCB1_EZ_DATA01
SPIS_SCB__EZ_DATA02 EQU CYREG_SCB1_EZ_DATA02
SPIS_SCB__EZ_DATA03 EQU CYREG_SCB1_EZ_DATA03
SPIS_SCB__EZ_DATA04 EQU CYREG_SCB1_EZ_DATA04
SPIS_SCB__EZ_DATA05 EQU CYREG_SCB1_EZ_DATA05
SPIS_SCB__EZ_DATA06 EQU CYREG_SCB1_EZ_DATA06
SPIS_SCB__EZ_DATA07 EQU CYREG_SCB1_EZ_DATA07
SPIS_SCB__EZ_DATA08 EQU CYREG_SCB1_EZ_DATA08
SPIS_SCB__EZ_DATA09 EQU CYREG_SCB1_EZ_DATA09
SPIS_SCB__EZ_DATA10 EQU CYREG_SCB1_EZ_DATA10
SPIS_SCB__EZ_DATA11 EQU CYREG_SCB1_EZ_DATA11
SPIS_SCB__EZ_DATA12 EQU CYREG_SCB1_EZ_DATA12
SPIS_SCB__EZ_DATA13 EQU CYREG_SCB1_EZ_DATA13
SPIS_SCB__EZ_DATA14 EQU CYREG_SCB1_EZ_DATA14
SPIS_SCB__EZ_DATA15 EQU CYREG_SCB1_EZ_DATA15
SPIS_SCB__EZ_DATA16 EQU CYREG_SCB1_EZ_DATA16
SPIS_SCB__EZ_DATA17 EQU CYREG_SCB1_EZ_DATA17
SPIS_SCB__EZ_DATA18 EQU CYREG_SCB1_EZ_DATA18
SPIS_SCB__EZ_DATA19 EQU CYREG_SCB1_EZ_DATA19
SPIS_SCB__EZ_DATA20 EQU CYREG_SCB1_EZ_DATA20
SPIS_SCB__EZ_DATA21 EQU CYREG_SCB1_EZ_DATA21
SPIS_SCB__EZ_DATA22 EQU CYREG_SCB1_EZ_DATA22
SPIS_SCB__EZ_DATA23 EQU CYREG_SCB1_EZ_DATA23
SPIS_SCB__EZ_DATA24 EQU CYREG_SCB1_EZ_DATA24
SPIS_SCB__EZ_DATA25 EQU CYREG_SCB1_EZ_DATA25
SPIS_SCB__EZ_DATA26 EQU CYREG_SCB1_EZ_DATA26
SPIS_SCB__EZ_DATA27 EQU CYREG_SCB1_EZ_DATA27
SPIS_SCB__EZ_DATA28 EQU CYREG_SCB1_EZ_DATA28
SPIS_SCB__EZ_DATA29 EQU CYREG_SCB1_EZ_DATA29
SPIS_SCB__EZ_DATA30 EQU CYREG_SCB1_EZ_DATA30
SPIS_SCB__EZ_DATA31 EQU CYREG_SCB1_EZ_DATA31
SPIS_SCB__I2C_CFG EQU CYREG_SCB1_I2C_CFG
SPIS_SCB__I2C_CTRL EQU CYREG_SCB1_I2C_CTRL
SPIS_SCB__I2C_M_CMD EQU CYREG_SCB1_I2C_M_CMD
SPIS_SCB__I2C_S_CMD EQU CYREG_SCB1_I2C_S_CMD
SPIS_SCB__I2C_STATUS EQU CYREG_SCB1_I2C_STATUS
SPIS_SCB__INTR_CAUSE EQU CYREG_SCB1_INTR_CAUSE
SPIS_SCB__INTR_I2C_EC EQU CYREG_SCB1_INTR_I2C_EC
SPIS_SCB__INTR_I2C_EC_MASK EQU CYREG_SCB1_INTR_I2C_EC_MASK
SPIS_SCB__INTR_I2C_EC_MASKED EQU CYREG_SCB1_INTR_I2C_EC_MASKED
SPIS_SCB__INTR_M EQU CYREG_SCB1_INTR_M
SPIS_SCB__INTR_M_MASK EQU CYREG_SCB1_INTR_M_MASK
SPIS_SCB__INTR_M_MASKED EQU CYREG_SCB1_INTR_M_MASKED
SPIS_SCB__INTR_M_SET EQU CYREG_SCB1_INTR_M_SET
SPIS_SCB__INTR_RX EQU CYREG_SCB1_INTR_RX
SPIS_SCB__INTR_RX_MASK EQU CYREG_SCB1_INTR_RX_MASK
SPIS_SCB__INTR_RX_MASKED EQU CYREG_SCB1_INTR_RX_MASKED
SPIS_SCB__INTR_RX_SET EQU CYREG_SCB1_INTR_RX_SET
SPIS_SCB__INTR_S EQU CYREG_SCB1_INTR_S
SPIS_SCB__INTR_S_MASK EQU CYREG_SCB1_INTR_S_MASK
SPIS_SCB__INTR_S_MASKED EQU CYREG_SCB1_INTR_S_MASKED
SPIS_SCB__INTR_S_SET EQU CYREG_SCB1_INTR_S_SET
SPIS_SCB__INTR_SPI_EC EQU CYREG_SCB1_INTR_SPI_EC
SPIS_SCB__INTR_SPI_EC_MASK EQU CYREG_SCB1_INTR_SPI_EC_MASK
SPIS_SCB__INTR_SPI_EC_MASKED EQU CYREG_SCB1_INTR_SPI_EC_MASKED
SPIS_SCB__INTR_TX EQU CYREG_SCB1_INTR_TX
SPIS_SCB__INTR_TX_MASK EQU CYREG_SCB1_INTR_TX_MASK
SPIS_SCB__INTR_TX_MASKED EQU CYREG_SCB1_INTR_TX_MASKED
SPIS_SCB__INTR_TX_SET EQU CYREG_SCB1_INTR_TX_SET
SPIS_SCB__RX_CTRL EQU CYREG_SCB1_RX_CTRL
SPIS_SCB__RX_FIFO_CTRL EQU CYREG_SCB1_RX_FIFO_CTRL
SPIS_SCB__RX_FIFO_RD EQU CYREG_SCB1_RX_FIFO_RD
SPIS_SCB__RX_FIFO_RD_SILENT EQU CYREG_SCB1_RX_FIFO_RD_SILENT
SPIS_SCB__RX_FIFO_STATUS EQU CYREG_SCB1_RX_FIFO_STATUS
SPIS_SCB__RX_MATCH EQU CYREG_SCB1_RX_MATCH
SPIS_SCB__SPI_CTRL EQU CYREG_SCB1_SPI_CTRL
SPIS_SCB__SPI_STATUS EQU CYREG_SCB1_SPI_STATUS
SPIS_SCB__SS0_POSISTION EQU 0
SPIS_SCB__SS1_POSISTION EQU 1
SPIS_SCB__SS2_POSISTION EQU 2
SPIS_SCB__SS3_POSISTION EQU 3
SPIS_SCB__STATUS EQU CYREG_SCB1_STATUS
SPIS_SCB__TX_CTRL EQU CYREG_SCB1_TX_CTRL
SPIS_SCB__TX_FIFO_CTRL EQU CYREG_SCB1_TX_FIFO_CTRL
SPIS_SCB__TX_FIFO_STATUS EQU CYREG_SCB1_TX_FIFO_STATUS
SPIS_SCB__TX_FIFO_WR EQU CYREG_SCB1_TX_FIFO_WR
SPIS_SCB__UART_CTRL EQU CYREG_SCB1_UART_CTRL
SPIS_SCB__UART_RX_CTRL EQU CYREG_SCB1_UART_RX_CTRL
SPIS_SCB__UART_RX_STATUS EQU CYREG_SCB1_UART_RX_STATUS
SPIS_SCB__UART_TX_CTRL EQU CYREG_SCB1_UART_TX_CTRL
SPIS_SCBCLK__DIVIDER_MASK EQU 0x0000FFFF
SPIS_SCBCLK__ENABLE EQU CYREG_CLK_DIVIDER_B00
SPIS_SCBCLK__ENABLE_MASK EQU 0x80000000
SPIS_SCBCLK__MASK EQU 0x80000000
SPIS_SCBCLK__REGISTER EQU CYREG_CLK_DIVIDER_B00
SPIS_sclk_s__0__DM__MASK EQU 0x1C0000
SPIS_sclk_s__0__DM__SHIFT EQU 18
SPIS_sclk_s__0__DR EQU CYREG_PRT0_DR
SPIS_sclk_s__0__HSIOM EQU CYREG_HSIOM_PORT_SEL0
SPIS_sclk_s__0__HSIOM_GPIO EQU 0
SPIS_sclk_s__0__HSIOM_MASK EQU 0x0F000000
SPIS_sclk_s__0__HSIOM_SHIFT EQU 24
SPIS_sclk_s__0__HSIOM_SPI EQU 15
SPIS_sclk_s__0__HSIOM_SPI_CLK EQU 15
SPIS_sclk_s__0__INTCFG EQU CYREG_PRT0_INTCFG
SPIS_sclk_s__0__INTSTAT EQU CYREG_PRT0_INTSTAT
SPIS_sclk_s__0__MASK EQU 0x40
SPIS_sclk_s__0__PA__CFG0 EQU CYREG_UDB_PA0_CFG0
SPIS_sclk_s__0__PA__CFG1 EQU CYREG_UDB_PA0_CFG1
SPIS_sclk_s__0__PA__CFG10 EQU CYREG_UDB_PA0_CFG10
SPIS_sclk_s__0__PA__CFG11 EQU CYREG_UDB_PA0_CFG11
SPIS_sclk_s__0__PA__CFG12 EQU CYREG_UDB_PA0_CFG12
SPIS_sclk_s__0__PA__CFG13 EQU CYREG_UDB_PA0_CFG13
SPIS_sclk_s__0__PA__CFG14 EQU CYREG_UDB_PA0_CFG14
SPIS_sclk_s__0__PA__CFG2 EQU CYREG_UDB_PA0_CFG2
SPIS_sclk_s__0__PA__CFG3 EQU CYREG_UDB_PA0_CFG3
SPIS_sclk_s__0__PA__CFG4 EQU CYREG_UDB_PA0_CFG4
SPIS_sclk_s__0__PA__CFG5 EQU CYREG_UDB_PA0_CFG5
SPIS_sclk_s__0__PA__CFG6 EQU CYREG_UDB_PA0_CFG6
SPIS_sclk_s__0__PA__CFG7 EQU CYREG_UDB_PA0_CFG7
SPIS_sclk_s__0__PA__CFG8 EQU CYREG_UDB_PA0_CFG8
SPIS_sclk_s__0__PA__CFG9 EQU CYREG_UDB_PA0_CFG9
SPIS_sclk_s__0__PC EQU CYREG_PRT0_PC
SPIS_sclk_s__0__PC2 EQU CYREG_PRT0_PC2
SPIS_sclk_s__0__PORT EQU 0
SPIS_sclk_s__0__PS EQU CYREG_PRT0_PS
SPIS_sclk_s__0__SHIFT EQU 6
SPIS_sclk_s__DR EQU CYREG_PRT0_DR
SPIS_sclk_s__INTCFG EQU CYREG_PRT0_INTCFG
SPIS_sclk_s__INTSTAT EQU CYREG_PRT0_INTSTAT
SPIS_sclk_s__MASK EQU 0x40
SPIS_sclk_s__PA__CFG0 EQU CYREG_UDB_PA0_CFG0
SPIS_sclk_s__PA__CFG1 EQU CYREG_UDB_PA0_CFG1
SPIS_sclk_s__PA__CFG10 EQU CYREG_UDB_PA0_CFG10
SPIS_sclk_s__PA__CFG11 EQU CYREG_UDB_PA0_CFG11
SPIS_sclk_s__PA__CFG12 EQU CYREG_UDB_PA0_CFG12
SPIS_sclk_s__PA__CFG13 EQU CYREG_UDB_PA0_CFG13
SPIS_sclk_s__PA__CFG14 EQU CYREG_UDB_PA0_CFG14
SPIS_sclk_s__PA__CFG2 EQU CYREG_UDB_PA0_CFG2
SPIS_sclk_s__PA__CFG3 EQU CYREG_UDB_PA0_CFG3
SPIS_sclk_s__PA__CFG4 EQU CYREG_UDB_PA0_CFG4
SPIS_sclk_s__PA__CFG5 EQU CYREG_UDB_PA0_CFG5
SPIS_sclk_s__PA__CFG6 EQU CYREG_UDB_PA0_CFG6
SPIS_sclk_s__PA__CFG7 EQU CYREG_UDB_PA0_CFG7
SPIS_sclk_s__PA__CFG8 EQU CYREG_UDB_PA0_CFG8
SPIS_sclk_s__PA__CFG9 EQU CYREG_UDB_PA0_CFG9
SPIS_sclk_s__PC EQU CYREG_PRT0_PC
SPIS_sclk_s__PC2 EQU CYREG_PRT0_PC2
SPIS_sclk_s__PORT EQU 0
SPIS_sclk_s__PS EQU CYREG_PRT0_PS
SPIS_sclk_s__SHIFT EQU 6
SPIS_ss_s__0__DM__MASK EQU 0xE00000
SPIS_ss_s__0__DM__SHIFT EQU 21
SPIS_ss_s__0__DR EQU CYREG_PRT0_DR
SPIS_ss_s__0__HSIOM EQU CYREG_HSIOM_PORT_SEL0
SPIS_ss_s__0__HSIOM_GPIO EQU 0
SPIS_ss_s__0__HSIOM_MASK EQU 0xF0000000
SPIS_ss_s__0__HSIOM_SHIFT EQU 28
SPIS_ss_s__0__HSIOM_SPI EQU 15
SPIS_ss_s__0__HSIOM_SPI_SSEL0 EQU 15
SPIS_ss_s__0__INTCFG EQU CYREG_PRT0_INTCFG
SPIS_ss_s__0__INTSTAT EQU CYREG_PRT0_INTSTAT
SPIS_ss_s__0__MASK EQU 0x80
SPIS_ss_s__0__PA__CFG0 EQU CYREG_UDB_PA0_CFG0
SPIS_ss_s__0__PA__CFG1 EQU CYREG_UDB_PA0_CFG1
SPIS_ss_s__0__PA__CFG10 EQU CYREG_UDB_PA0_CFG10
SPIS_ss_s__0__PA__CFG11 EQU CYREG_UDB_PA0_CFG11
SPIS_ss_s__0__PA__CFG12 EQU CYREG_UDB_PA0_CFG12
SPIS_ss_s__0__PA__CFG13 EQU CYREG_UDB_PA0_CFG13
SPIS_ss_s__0__PA__CFG14 EQU CYREG_UDB_PA0_CFG14
SPIS_ss_s__0__PA__CFG2 EQU CYREG_UDB_PA0_CFG2
SPIS_ss_s__0__PA__CFG3 EQU CYREG_UDB_PA0_CFG3
SPIS_ss_s__0__PA__CFG4 EQU CYREG_UDB_PA0_CFG4
SPIS_ss_s__0__PA__CFG5 EQU CYREG_UDB_PA0_CFG5
SPIS_ss_s__0__PA__CFG6 EQU CYREG_UDB_PA0_CFG6
SPIS_ss_s__0__PA__CFG7 EQU CYREG_UDB_PA0_CFG7
SPIS_ss_s__0__PA__CFG8 EQU CYREG_UDB_PA0_CFG8
SPIS_ss_s__0__PA__CFG9 EQU CYREG_UDB_PA0_CFG9
SPIS_ss_s__0__PC EQU CYREG_PRT0_PC
SPIS_ss_s__0__PC2 EQU CYREG_PRT0_PC2
SPIS_ss_s__0__PORT EQU 0
SPIS_ss_s__0__PS EQU CYREG_PRT0_PS
SPIS_ss_s__0__SHIFT EQU 7
SPIS_ss_s__DR EQU CYREG_PRT0_DR
SPIS_ss_s__INTCFG EQU CYREG_PRT0_INTCFG
SPIS_ss_s__INTSTAT EQU CYREG_PRT0_INTSTAT
SPIS_ss_s__MASK EQU 0x80
SPIS_ss_s__PA__CFG0 EQU CYREG_UDB_PA0_CFG0
SPIS_ss_s__PA__CFG1 EQU CYREG_UDB_PA0_CFG1
SPIS_ss_s__PA__CFG10 EQU CYREG_UDB_PA0_CFG10
SPIS_ss_s__PA__CFG11 EQU CYREG_UDB_PA0_CFG11
SPIS_ss_s__PA__CFG12 EQU CYREG_UDB_PA0_CFG12
SPIS_ss_s__PA__CFG13 EQU CYREG_UDB_PA0_CFG13
SPIS_ss_s__PA__CFG14 EQU CYREG_UDB_PA0_CFG14
SPIS_ss_s__PA__CFG2 EQU CYREG_UDB_PA0_CFG2
SPIS_ss_s__PA__CFG3 EQU CYREG_UDB_PA0_CFG3
SPIS_ss_s__PA__CFG4 EQU CYREG_UDB_PA0_CFG4
SPIS_ss_s__PA__CFG5 EQU CYREG_UDB_PA0_CFG5
SPIS_ss_s__PA__CFG6 EQU CYREG_UDB_PA0_CFG6
SPIS_ss_s__PA__CFG7 EQU CYREG_UDB_PA0_CFG7
SPIS_ss_s__PA__CFG8 EQU CYREG_UDB_PA0_CFG8
SPIS_ss_s__PA__CFG9 EQU CYREG_UDB_PA0_CFG9
SPIS_ss_s__PC EQU CYREG_PRT0_PC
SPIS_ss_s__PC2 EQU CYREG_PRT0_PC2
SPIS_ss_s__PORT EQU 0
SPIS_ss_s__PS EQU CYREG_PRT0_PS
SPIS_ss_s__SHIFT EQU 7

/* SW1 */
SW1__0__DM__MASK EQU 0x38
SW1__0__DM__SHIFT EQU 3
SW1__0__DR EQU CYREG_PRT0_DR
SW1__0__HSIOM EQU CYREG_HSIOM_PORT_SEL0
SW1__0__HSIOM_MASK EQU 0x000000F0
SW1__0__HSIOM_SHIFT EQU 4
SW1__0__INTCFG EQU CYREG_PRT0_INTCFG
SW1__0__INTSTAT EQU CYREG_PRT0_INTSTAT
SW1__0__MASK EQU 0x02
SW1__0__PA__CFG0 EQU CYREG_UDB_PA0_CFG0
SW1__0__PA__CFG1 EQU CYREG_UDB_PA0_CFG1
SW1__0__PA__CFG10 EQU CYREG_UDB_PA0_CFG10
SW1__0__PA__CFG11 EQU CYREG_UDB_PA0_CFG11
SW1__0__PA__CFG12 EQU CYREG_UDB_PA0_CFG12
SW1__0__PA__CFG13 EQU CYREG_UDB_PA0_CFG13
SW1__0__PA__CFG14 EQU CYREG_UDB_PA0_CFG14
SW1__0__PA__CFG2 EQU CYREG_UDB_PA0_CFG2
SW1__0__PA__CFG3 EQU CYREG_UDB_PA0_CFG3
SW1__0__PA__CFG4 EQU CYREG_UDB_PA0_CFG4
SW1__0__PA__CFG5 EQU CYREG_UDB_PA0_CFG5
SW1__0__PA__CFG6 EQU CYREG_UDB_PA0_CFG6
SW1__0__PA__CFG7 EQU CYREG_UDB_PA0_CFG7
SW1__0__PA__CFG8 EQU CYREG_UDB_PA0_CFG8
SW1__0__PA__CFG9 EQU CYREG_UDB_PA0_CFG9
SW1__0__PC EQU CYREG_PRT0_PC
SW1__0__PC2 EQU CYREG_PRT0_PC2
SW1__0__PORT EQU 0
SW1__0__PS EQU CYREG_PRT0_PS
SW1__0__SHIFT EQU 1
SW1__DR EQU CYREG_PRT0_DR
SW1__INTCFG EQU CYREG_PRT0_INTCFG
SW1__INTSTAT EQU CYREG_PRT0_INTSTAT
SW1__MASK EQU 0x02
SW1__PA__CFG0 EQU CYREG_UDB_PA0_CFG0
SW1__PA__CFG1 EQU CYREG_UDB_PA0_CFG1
SW1__PA__CFG10 EQU CYREG_UDB_PA0_CFG10
SW1__PA__CFG11 EQU CYREG_UDB_PA0_CFG11
SW1__PA__CFG12 EQU CYREG_UDB_PA0_CFG12
SW1__PA__CFG13 EQU CYREG_UDB_PA0_CFG13
SW1__PA__CFG14 EQU CYREG_UDB_PA0_CFG14
SW1__PA__CFG2 EQU CYREG_UDB_PA0_CFG2
SW1__PA__CFG3 EQU CYREG_UDB_PA0_CFG3
SW1__PA__CFG4 EQU CYREG_UDB_PA0_CFG4
SW1__PA__CFG5 EQU CYREG_UDB_PA0_CFG5
SW1__PA__CFG6 EQU CYREG_UDB_PA0_CFG6
SW1__PA__CFG7 EQU CYREG_UDB_PA0_CFG7
SW1__PA__CFG8 EQU CYREG_UDB_PA0_CFG8
SW1__PA__CFG9 EQU CYREG_UDB_PA0_CFG9
SW1__PC EQU CYREG_PRT0_PC
SW1__PC2 EQU CYREG_PRT0_PC2
SW1__PORT EQU 0
SW1__PS EQU CYREG_PRT0_PS
SW1__SHIFT EQU 1

/* StripLights_B_WS2811 */
StripLights_B_WS2811_ctrl__0__MASK EQU 0x01
StripLights_B_WS2811_ctrl__0__POS EQU 0
StripLights_B_WS2811_ctrl__16BIT_CONTROL_AUX_CTL_REG EQU CYREG_UDB_W16_ACTL_00
StripLights_B_WS2811_ctrl__16BIT_CONTROL_CONTROL_REG EQU CYREG_UDB_W16_CTL_00
StripLights_B_WS2811_ctrl__16BIT_CONTROL_COUNT_REG EQU CYREG_UDB_W16_CTL_00
StripLights_B_WS2811_ctrl__16BIT_COUNT_CONTROL_REG EQU CYREG_UDB_W16_CTL_00
StripLights_B_WS2811_ctrl__16BIT_COUNT_COUNT_REG EQU CYREG_UDB_W16_CTL_00
StripLights_B_WS2811_ctrl__16BIT_MASK_MASK_REG EQU CYREG_UDB_W16_MSK_00
StripLights_B_WS2811_ctrl__16BIT_MASK_PERIOD_REG EQU CYREG_UDB_W16_MSK_00
StripLights_B_WS2811_ctrl__16BIT_PERIOD_MASK_REG EQU CYREG_UDB_W16_MSK_00
StripLights_B_WS2811_ctrl__16BIT_PERIOD_PERIOD_REG EQU CYREG_UDB_W16_MSK_00
StripLights_B_WS2811_ctrl__3__MASK EQU 0x08
StripLights_B_WS2811_ctrl__3__POS EQU 3
StripLights_B_WS2811_ctrl__32BIT_CONTROL_AUX_CTL_REG EQU CYREG_UDB_W32_ACTL_00
StripLights_B_WS2811_ctrl__32BIT_CONTROL_REG EQU CYREG_UDB_W32_CTL_00
StripLights_B_WS2811_ctrl__32BIT_COUNT_REG EQU CYREG_UDB_W32_CTL_00
StripLights_B_WS2811_ctrl__32BIT_PERIOD_REG EQU CYREG_UDB_W32_MSK_00
StripLights_B_WS2811_ctrl__4__MASK EQU 0x10
StripLights_B_WS2811_ctrl__4__POS EQU 4
StripLights_B_WS2811_ctrl__5__MASK EQU 0x20
StripLights_B_WS2811_ctrl__5__POS EQU 5
StripLights_B_WS2811_ctrl__CONTROL_AUX_CTL_REG EQU CYREG_UDB_W8_ACTL_00
StripLights_B_WS2811_ctrl__CONTROL_REG EQU CYREG_UDB_W8_CTL_00
StripLights_B_WS2811_ctrl__CONTROL_ST_REG EQU CYREG_UDB_CAT16_CTL_ST_00
StripLights_B_WS2811_ctrl__COUNT_REG EQU CYREG_UDB_W8_CTL_00
StripLights_B_WS2811_ctrl__COUNT_ST_REG EQU CYREG_UDB_CAT16_CTL_ST_00
StripLights_B_WS2811_ctrl__MASK EQU 0x39
StripLights_B_WS2811_ctrl__MASK_CTL_AUX_CTL_REG EQU CYREG_UDB_CAT16_ACTL_MSK_00
StripLights_B_WS2811_ctrl__PER_CTL_AUX_CTL_REG EQU CYREG_UDB_CAT16_ACTL_MSK_00
StripLights_B_WS2811_ctrl__PERIOD_REG EQU CYREG_UDB_W8_MSK_00
StripLights_B_WS2811_dshifter_u0__16BIT_A0_REG EQU CYREG_UDB_W16_A0_00
StripLights_B_WS2811_dshifter_u0__16BIT_A1_REG EQU CYREG_UDB_W16_A1_00
StripLights_B_WS2811_dshifter_u0__16BIT_D0_REG EQU CYREG_UDB_W16_D0_00
StripLights_B_WS2811_dshifter_u0__16BIT_D1_REG EQU CYREG_UDB_W16_D1_00
StripLights_B_WS2811_dshifter_u0__16BIT_DP_AUX_CTL_REG EQU CYREG_UDB_W16_ACTL_00
StripLights_B_WS2811_dshifter_u0__16BIT_F0_REG EQU CYREG_UDB_W16_F0_00
StripLights_B_WS2811_dshifter_u0__16BIT_F1_REG EQU CYREG_UDB_W16_F1_00
StripLights_B_WS2811_dshifter_u0__32BIT_A0_REG EQU CYREG_UDB_W32_A0_00
StripLights_B_WS2811_dshifter_u0__32BIT_A1_REG EQU CYREG_UDB_W32_A1_00
StripLights_B_WS2811_dshifter_u0__32BIT_D0_REG EQU CYREG_UDB_W32_D0_00
StripLights_B_WS2811_dshifter_u0__32BIT_D1_REG EQU CYREG_UDB_W32_D1_00
StripLights_B_WS2811_dshifter_u0__32BIT_DP_AUX_CTL_REG EQU CYREG_UDB_W32_ACTL_00
StripLights_B_WS2811_dshifter_u0__32BIT_F0_REG EQU CYREG_UDB_W32_F0_00
StripLights_B_WS2811_dshifter_u0__32BIT_F1_REG EQU CYREG_UDB_W32_F1_00
StripLights_B_WS2811_dshifter_u0__A0_A1_REG EQU CYREG_UDB_CAT16_A_00
StripLights_B_WS2811_dshifter_u0__A0_REG EQU CYREG_UDB_W8_A0_00
StripLights_B_WS2811_dshifter_u0__A1_REG EQU CYREG_UDB_W8_A1_00
StripLights_B_WS2811_dshifter_u0__D0_D1_REG EQU CYREG_UDB_CAT16_D_00
StripLights_B_WS2811_dshifter_u0__D0_REG EQU CYREG_UDB_W8_D0_00
StripLights_B_WS2811_dshifter_u0__D1_REG EQU CYREG_UDB_W8_D1_00
StripLights_B_WS2811_dshifter_u0__DP_AUX_CTL_REG EQU CYREG_UDB_W8_ACTL_00
StripLights_B_WS2811_dshifter_u0__F0_F1_REG EQU CYREG_UDB_CAT16_F_00
StripLights_B_WS2811_dshifter_u0__F0_REG EQU CYREG_UDB_W8_F0_00
StripLights_B_WS2811_dshifter_u0__F1_REG EQU CYREG_UDB_W8_F1_00
StripLights_B_WS2811_dshifter_u0__MSK_DP_AUX_CTL_REG EQU CYREG_UDB_CAT16_ACTL_MSK_00
StripLights_B_WS2811_dshifter_u0__PER_DP_AUX_CTL_REG EQU CYREG_UDB_CAT16_ACTL_MSK_00
StripLights_B_WS2811_pwm8_u0__16BIT_A0_REG EQU CYREG_UDB_W16_A0_01
StripLights_B_WS2811_pwm8_u0__16BIT_A1_REG EQU CYREG_UDB_W16_A1_01
StripLights_B_WS2811_pwm8_u0__16BIT_D0_REG EQU CYREG_UDB_W16_D0_01
StripLights_B_WS2811_pwm8_u0__16BIT_D1_REG EQU CYREG_UDB_W16_D1_01
StripLights_B_WS2811_pwm8_u0__16BIT_DP_AUX_CTL_REG EQU CYREG_UDB_W16_ACTL_01
StripLights_B_WS2811_pwm8_u0__16BIT_F0_REG EQU CYREG_UDB_W16_F0_01
StripLights_B_WS2811_pwm8_u0__16BIT_F1_REG EQU CYREG_UDB_W16_F1_01
StripLights_B_WS2811_pwm8_u0__A0_A1_REG EQU CYREG_UDB_CAT16_A_01
StripLights_B_WS2811_pwm8_u0__A0_REG EQU CYREG_UDB_W8_A0_01
StripLights_B_WS2811_pwm8_u0__A1_REG EQU CYREG_UDB_W8_A1_01
StripLights_B_WS2811_pwm8_u0__D0_D1_REG EQU CYREG_UDB_CAT16_D_01
StripLights_B_WS2811_pwm8_u0__D0_REG EQU CYREG_UDB_W8_D0_01
StripLights_B_WS2811_pwm8_u0__D1_REG EQU CYREG_UDB_W8_D1_01
StripLights_B_WS2811_pwm8_u0__DP_AUX_CTL_REG EQU CYREG_UDB_W8_ACTL_01
StripLights_B_WS2811_pwm8_u0__F0_F1_REG EQU CYREG_UDB_CAT16_F_01
StripLights_B_WS2811_pwm8_u0__F0_REG EQU CYREG_UDB_W8_F0_01
StripLights_B_WS2811_pwm8_u0__F1_REG EQU CYREG_UDB_W8_F1_01
StripLights_B_WS2811_pwm8_u0__MSK_DP_AUX_CTL_REG EQU CYREG_UDB_CAT16_ACTL_MSK_01
StripLights_B_WS2811_pwm8_u0__PER_DP_AUX_CTL_REG EQU CYREG_UDB_CAT16_ACTL_MSK_01
StripLights_B_WS2811_StatusReg__0__MASK EQU 0x01
StripLights_B_WS2811_StatusReg__0__POS EQU 0
StripLights_B_WS2811_StatusReg__1__MASK EQU 0x02
StripLights_B_WS2811_StatusReg__1__POS EQU 1
StripLights_B_WS2811_StatusReg__16BIT_STATUS_AUX_CTL_REG EQU CYREG_UDB_W16_ACTL_00
StripLights_B_WS2811_StatusReg__16BIT_STATUS_REG EQU CYREG_UDB_W16_ST_00
StripLights_B_WS2811_StatusReg__32BIT_MASK_REG EQU CYREG_UDB_W32_MSK_00
StripLights_B_WS2811_StatusReg__32BIT_STATUS_AUX_CTL_REG EQU CYREG_UDB_W32_ACTL_00
StripLights_B_WS2811_StatusReg__32BIT_STATUS_REG EQU CYREG_UDB_W32_ST_00
StripLights_B_WS2811_StatusReg__6__MASK EQU 0x40
StripLights_B_WS2811_StatusReg__6__POS EQU 6
StripLights_B_WS2811_StatusReg__7__MASK EQU 0x80
StripLights_B_WS2811_StatusReg__7__POS EQU 7
StripLights_B_WS2811_StatusReg__MASK EQU 0xC3
StripLights_B_WS2811_StatusReg__MASK_REG EQU CYREG_UDB_W8_MSK_00
StripLights_B_WS2811_StatusReg__MASK_ST_AUX_CTL_REG EQU CYREG_UDB_CAT16_ACTL_MSK_00
StripLights_B_WS2811_StatusReg__PER_ST_AUX_CTL_REG EQU CYREG_UDB_CAT16_ACTL_MSK_00
StripLights_B_WS2811_StatusReg__STATUS_AUX_CTL_REG EQU CYREG_UDB_W8_ACTL_00
StripLights_B_WS2811_StatusReg__STATUS_CNT_REG EQU CYREG_UDB_CAT16_CTL_ST_00
StripLights_B_WS2811_StatusReg__STATUS_CONTROL_REG EQU CYREG_UDB_CAT16_CTL_ST_00
StripLights_B_WS2811_StatusReg__STATUS_REG EQU CYREG_UDB_W8_ST_00

/* StripLights_cisr */
StripLights_cisr__INTC_CLR_EN_REG EQU CYREG_CM0_ICER
StripLights_cisr__INTC_CLR_PD_REG EQU CYREG_CM0_ICPR
StripLights_cisr__INTC_MASK EQU 0x01
StripLights_cisr__INTC_NUMBER EQU 0
StripLights_cisr__INTC_PRIOR_MASK EQU 0xC0
StripLights_cisr__INTC_PRIOR_NUM EQU 3
StripLights_cisr__INTC_PRIOR_REG EQU CYREG_CM0_IPR0
StripLights_cisr__INTC_SET_EN_REG EQU CYREG_CM0_ISER
StripLights_cisr__INTC_SET_PD_REG EQU CYREG_CM0_ISPR

/* StripLights_fisr */
StripLights_fisr__INTC_CLR_EN_REG EQU CYREG_CM0_ICER
StripLights_fisr__INTC_CLR_PD_REG EQU CYREG_CM0_ICPR
StripLights_fisr__INTC_MASK EQU 0x04
StripLights_fisr__INTC_NUMBER EQU 2
StripLights_fisr__INTC_PRIOR_MASK EQU 0xC00000
StripLights_fisr__INTC_PRIOR_NUM EQU 3
StripLights_fisr__INTC_PRIOR_REG EQU CYREG_CM0_IPR0
StripLights_fisr__INTC_SET_EN_REG EQU CYREG_CM0_ISER
StripLights_fisr__INTC_SET_PD_REG EQU CYREG_CM0_ISPR

/* Miscellaneous */
StripLights_HFCLK__DIVIDER_MASK EQU 0x0000FFFF
StripLights_HFCLK__ENABLE EQU CYREG_CLK_DIVIDER_A00
StripLights_HFCLK__ENABLE_MASK EQU 0x80000000
StripLights_HFCLK__MASK EQU 0x80000000
StripLights_HFCLK__REGISTER EQU CYREG_CLK_DIVIDER_A00
StripLights_StringSel_Sync_ctrl_reg__0__MASK EQU 0x01
StripLights_StringSel_Sync_ctrl_reg__0__POS EQU 0
StripLights_StringSel_Sync_ctrl_reg__1__MASK EQU 0x02
StripLights_StringSel_Sync_ctrl_reg__1__POS EQU 1
StripLights_StringSel_Sync_ctrl_reg__16BIT_CONTROL_AUX_CTL_REG EQU CYREG_UDB_W16_ACTL_01
StripLights_StringSel_Sync_ctrl_reg__16BIT_CONTROL_CONTROL_REG EQU CYREG_UDB_W16_CTL_01
StripLights_StringSel_Sync_ctrl_reg__16BIT_CONTROL_COUNT_REG EQU CYREG_UDB_W16_CTL_01
StripLights_StringSel_Sync_ctrl_reg__16BIT_COUNT_CONTROL_REG EQU CYREG_UDB_W16_CTL_01
StripLights_StringSel_Sync_ctrl_reg__16BIT_COUNT_COUNT_REG EQU CYREG_UDB_W16_CTL_01
StripLights_StringSel_Sync_ctrl_reg__16BIT_MASK_MASK_REG EQU CYREG_UDB_W16_MSK_01
StripLights_StringSel_Sync_ctrl_reg__16BIT_MASK_PERIOD_REG EQU CYREG_UDB_W16_MSK_01
StripLights_StringSel_Sync_ctrl_reg__16BIT_PERIOD_MASK_REG EQU CYREG_UDB_W16_MSK_01
StripLights_StringSel_Sync_ctrl_reg__16BIT_PERIOD_PERIOD_REG EQU CYREG_UDB_W16_MSK_01
StripLights_StringSel_Sync_ctrl_reg__2__MASK EQU 0x04
StripLights_StringSel_Sync_ctrl_reg__2__POS EQU 2
StripLights_StringSel_Sync_ctrl_reg__3__MASK EQU 0x08
StripLights_StringSel_Sync_ctrl_reg__3__POS EQU 3
StripLights_StringSel_Sync_ctrl_reg__CONTROL_AUX_CTL_REG EQU CYREG_UDB_W8_ACTL_01
StripLights_StringSel_Sync_ctrl_reg__CONTROL_REG EQU CYREG_UDB_W8_CTL_01
StripLights_StringSel_Sync_ctrl_reg__CONTROL_ST_REG EQU CYREG_UDB_CAT16_CTL_ST_01
StripLights_StringSel_Sync_ctrl_reg__COUNT_REG EQU CYREG_UDB_W8_CTL_01
StripLights_StringSel_Sync_ctrl_reg__COUNT_ST_REG EQU CYREG_UDB_CAT16_CTL_ST_01
StripLights_StringSel_Sync_ctrl_reg__MASK EQU 0x0F
StripLights_StringSel_Sync_ctrl_reg__MASK_CTL_AUX_CTL_REG EQU CYREG_UDB_CAT16_ACTL_MSK_01
StripLights_StringSel_Sync_ctrl_reg__PER_CTL_AUX_CTL_REG EQU CYREG_UDB_CAT16_ACTL_MSK_01
StripLights_StringSel_Sync_ctrl_reg__PERIOD_REG EQU CYREG_UDB_W8_MSK_01
CYDEV_BCLK__HFCLK__HZ EQU 24000000
CYDEV_BCLK__HFCLK__KHZ EQU 24000
CYDEV_BCLK__HFCLK__MHZ EQU 24
CYDEV_BCLK__SYSCLK__HZ EQU 24000000
CYDEV_BCLK__SYSCLK__KHZ EQU 24000
CYDEV_BCLK__SYSCLK__MHZ EQU 24
CYDEV_CHIP_DIE_LEOPARD EQU 1
CYDEV_CHIP_DIE_PSOC4A EQU 16
CYDEV_CHIP_DIE_PSOC5LP EQU 2
CYDEV_CHIP_DIE_PSOC5TM EQU 3
CYDEV_CHIP_DIE_TMA4 EQU 4
CYDEV_CHIP_DIE_UNKNOWN EQU 0
CYDEV_CHIP_FAMILY_FM0P EQU 5
CYDEV_CHIP_FAMILY_FM3 EQU 6
CYDEV_CHIP_FAMILY_FM4 EQU 7
CYDEV_CHIP_FAMILY_PSOC3 EQU 1
CYDEV_CHIP_FAMILY_PSOC4 EQU 2
CYDEV_CHIP_FAMILY_PSOC5 EQU 3
CYDEV_CHIP_FAMILY_PSOC6 EQU 4
CYDEV_CHIP_FAMILY_UNKNOWN EQU 0
CYDEV_CHIP_FAMILY_USED EQU CYDEV_CHIP_FAMILY_PSOC4
CYDEV_CHIP_JTAG_ID EQU 0x04C81193
CYDEV_CHIP_MEMBER_3A EQU 1
CYDEV_CHIP_MEMBER_4A EQU 16
CYDEV_CHIP_MEMBER_4D EQU 12
CYDEV_CHIP_MEMBER_4E EQU 6
CYDEV_CHIP_MEMBER_4F EQU 17
CYDEV_CHIP_MEMBER_4G EQU 4
CYDEV_CHIP_MEMBER_4H EQU 15
CYDEV_CHIP_MEMBER_4I EQU 21
CYDEV_CHIP_MEMBER_4J EQU 13
CYDEV_CHIP_MEMBER_4K EQU 14
CYDEV_CHIP_MEMBER_4L EQU 20
CYDEV_CHIP_MEMBER_4M EQU 19
CYDEV_CHIP_MEMBER_4N EQU 9
CYDEV_CHIP_MEMBER_4O EQU 7
CYDEV_CHIP_MEMBER_4P EQU 18
CYDEV_CHIP_MEMBER_4Q EQU 11
CYDEV_CHIP_MEMBER_4R EQU 8
CYDEV_CHIP_MEMBER_4S EQU 10
CYDEV_CHIP_MEMBER_4U EQU 5
CYDEV_CHIP_MEMBER_5A EQU 3
CYDEV_CHIP_MEMBER_5B EQU 2
CYDEV_CHIP_MEMBER_6A EQU 22
CYDEV_CHIP_MEMBER_FM3 EQU 26
CYDEV_CHIP_MEMBER_FM4 EQU 27
CYDEV_CHIP_MEMBER_PDL_FM0P_TYPE1 EQU 23
CYDEV_CHIP_MEMBER_PDL_FM0P_TYPE2 EQU 24
CYDEV_CHIP_MEMBER_PDL_FM0P_TYPE3 EQU 25
CYDEV_CHIP_MEMBER_UNKNOWN EQU 0
CYDEV_CHIP_MEMBER_USED EQU CYDEV_CHIP_MEMBER_4A
CYDEV_CHIP_DIE_EXPECT EQU CYDEV_CHIP_MEMBER_USED
CYDEV_CHIP_DIE_ACTUAL EQU CYDEV_CHIP_DIE_EXPECT
CYDEV_CHIP_REV_LEOPARD_ES1 EQU 0
CYDEV_CHIP_REV_LEOPARD_ES2 EQU 1
CYDEV_CHIP_REV_LEOPARD_ES3 EQU 3
CYDEV_CHIP_REV_LEOPARD_PRODUCTION EQU 3
CYDEV_CHIP_REV_PSOC4A_ES0 EQU 17
CYDEV_CHIP_REV_PSOC4A_PRODUCTION EQU 17
CYDEV_CHIP_REV_PSOC5LP_ES0 EQU 0
CYDEV_CHIP_REV_PSOC5LP_PRODUCTION EQU 0
CYDEV_CHIP_REV_PSOC5TM_ES0 EQU 0
CYDEV_CHIP_REV_PSOC5TM_ES1 EQU 1
CYDEV_CHIP_REV_PSOC5TM_PRODUCTION EQU 1
CYDEV_CHIP_REV_TMA4_ES EQU 17
CYDEV_CHIP_REV_TMA4_ES2 EQU 33
CYDEV_CHIP_REV_TMA4_PRODUCTION EQU 17
CYDEV_CHIP_REVISION_3A_ES1 EQU 0
CYDEV_CHIP_REVISION_3A_ES2 EQU 1
CYDEV_CHIP_REVISION_3A_ES3 EQU 3
CYDEV_CHIP_REVISION_3A_PRODUCTION EQU 3
CYDEV_CHIP_REVISION_4A_ES0 EQU 17
CYDEV_CHIP_REVISION_4A_PRODUCTION EQU 17
CYDEV_CHIP_REVISION_4D_PRODUCTION EQU 0
CYDEV_CHIP_REVISION_4E_PRODUCTION EQU 0
CYDEV_CHIP_REVISION_4F_PRODUCTION EQU 0
CYDEV_CHIP_REVISION_4F_PRODUCTION_256DMA EQU 0
CYDEV_CHIP_REVISION_4F_PRODUCTION_256K EQU 0
CYDEV_CHIP_REVISION_4G_ES EQU 17
CYDEV_CHIP_REVISION_4G_ES2 EQU 33
CYDEV_CHIP_REVISION_4G_PRODUCTION EQU 17
CYDEV_CHIP_REVISION_4H_PRODUCTION EQU 0
CYDEV_CHIP_REVISION_4I_PRODUCTION EQU 0
CYDEV_CHIP_REVISION_4J_PRODUCTION EQU 0
CYDEV_CHIP_REVISION_4K_PRODUCTION EQU 0
CYDEV_CHIP_REVISION_4L_PRODUCTION EQU 0
CYDEV_CHIP_REVISION_4M_PRODUCTION EQU 0
CYDEV_CHIP_REVISION_4N_PRODUCTION EQU 0
CYDEV_CHIP_REVISION_4O_PRODUCTION EQU 0
CYDEV_CHIP_REVISION_4P_PRODUCTION EQU 0
CYDEV_CHIP_REVISION_4Q_PRODUCTION EQU 0
CYDEV_CHIP_REVISION_4R_PRODUCTION EQU 0
CYDEV_CHIP_REVISION_4S_PRODUCTION EQU 0
CYDEV_CHIP_REVISION_4U_PRODUCTION EQU 0
CYDEV_CHIP_REVISION_5A_ES0 EQU 0
CYDEV_CHIP_REVISION_5A_ES1 EQU 1
CYDEV_CHIP_REVISION_5A_PRODUCTION EQU 1
CYDEV_CHIP_REVISION_5B_ES0 EQU 0
CYDEV_CHIP_REVISION_5B_PRODUCTION EQU 0
CYDEV_CHIP_REVISION_6A_NO_UDB EQU 0
CYDEV_CHIP_REVISION_6A_PRODUCTION EQU 0
CYDEV_CHIP_REVISION_FM3_PRODUCTION EQU 0
CYDEV_CHIP_REVISION_FM4_PRODUCTION EQU 0
CYDEV_CHIP_REVISION_PDL_FM0P_TYPE1_PRODUCTION EQU 0
CYDEV_CHIP_REVISION_PDL_FM0P_TYPE2_PRODUCTION EQU 0
CYDEV_CHIP_REVISION_PDL_FM0P_TYPE3_PRODUCTION EQU 0
CYDEV_CHIP_REVISION_USED EQU CYDEV_CHIP_REVISION_4A_PRODUCTION
CYDEV_CHIP_REV_EXPECT EQU CYDEV_CHIP_REVISION_USED
CYDEV_CONFIG_READ_ACCELERATOR EQU 1
CYDEV_CONFIG_UNUSED_IO_AllowButWarn EQU 0
CYDEV_CONFIG_UNUSED_IO_AllowWithInfo EQU 1
CYDEV_CONFIG_UNUSED_IO_Disallowed EQU 2
CYDEV_CONFIG_UNUSED_IO EQU CYDEV_CONFIG_UNUSED_IO_Disallowed
CYDEV_CONFIGURATION_COMPRESSED EQU 1
CYDEV_CONFIGURATION_MODE_COMPRESSED EQU 0
CYDEV_CONFIGURATION_MODE EQU CYDEV_CONFIGURATION_MODE_COMPRESSED
CYDEV_CONFIGURATION_MODE_DMA EQU 2
CYDEV_CONFIGURATION_MODE_UNCOMPRESSED EQU 1
CYDEV_DEBUG_PROTECT_KILL EQU 4
CYDEV_DEBUG_PROTECT_OPEN EQU 1
CYDEV_DEBUG_PROTECT EQU CYDEV_DEBUG_PROTECT_OPEN
CYDEV_DEBUG_PROTECT_PROTECTED EQU 2
CYDEV_DEBUGGING_DPS_Disable EQU 3
CYDEV_DEBUGGING_DPS_SWD EQU 2
CYDEV_DEBUGGING_DPS EQU CYDEV_DEBUGGING_DPS_SWD
CYDEV_DEBUGGING_ENABLE EQU 1
CYDEV_DFT_SELECT_CLK0 EQU 1
CYDEV_DFT_SELECT_CLK1 EQU 2
CYDEV_HEAP_SIZE EQU 0x80
CYDEV_IMO_TRIMMED_BY_USB EQU 0
CYDEV_IMO_TRIMMED_BY_WCO EQU 0
CYDEV_IS_EXPORTING_CODE EQU 0
CYDEV_IS_IMPORTING_CODE EQU 0
CYDEV_PROJ_TYPE EQU 0
CYDEV_PROJ_TYPE_BOOTLOADER EQU 1
CYDEV_PROJ_TYPE_LAUNCHER EQU 5
CYDEV_PROJ_TYPE_LOADABLE EQU 2
CYDEV_PROJ_TYPE_LOADABLEANDBOOTLOADER EQU 4
CYDEV_PROJ_TYPE_MULTIAPPBOOTLOADER EQU 3
CYDEV_PROJ_TYPE_STANDARD EQU 0
CYDEV_STACK_SIZE EQU 0x0400
CYDEV_USE_BUNDLED_CMSIS EQU 1
CYDEV_VARIABLE_VDDA EQU 1
CYDEV_VDDA_MV EQU 3300
CYDEV_VDDD_MV EQU 3300
CYDEV_WDT_GENERATE_ISR EQU 1
CYIPBLOCK_M0S8_CTBM_VERSION EQU 0
CYIPBLOCK_m0s8cpuss_VERSION EQU 0
CYIPBLOCK_m0s8csd_VERSION EQU 0
CYIPBLOCK_m0s8gpio2_VERSION EQU 0
CYIPBLOCK_m0s8hsiom4a_VERSION EQU 0
CYIPBLOCK_m0s8lcd_VERSION EQU 0
CYIPBLOCK_m0s8lpcomp_VERSION EQU 0
CYIPBLOCK_m0s8pclk_VERSION EQU 0
CYIPBLOCK_m0s8sar_VERSION EQU 0
CYIPBLOCK_m0s8scb_VERSION EQU 0
CYIPBLOCK_m0s8srssv2_VERSION EQU 1
CYIPBLOCK_m0s8tcpwm_VERSION EQU 0
CYIPBLOCK_m0s8udbif_VERSION EQU 0
CYIPBLOCK_S8_GPIO_VERSION EQU 2
CYDEV_BOOTLOADER_ENABLE EQU 0

#endif /* INCLUDED_CYFITTERIAR_INC */
